## drivers/gpio/Kconfig
```kconfig
#  Copyright (c) 2025 Tenstorrent AI ULC
#  SPDX-License-Identifier: Apache-2.0

if GPIO

menu "Sensor Drivers"

# zephyr-keep-sorted-start
rsource "Kconfig.tca9554a"
# zephyr-keep-sorted-stop

endmenu

endif
```

## drivers/gpio/Kconfig.tca9554a
```kconfig
# Copyright(c) 2022 Chromium OS Authors
# Copyright(c) 2025 Tenstorrent AI ULC
# SPDX-License-Identifier: Apache-2.0

menuconfig GPIO_TCA6554A
    bool "TCA6554A driver"
    default y
    depends on DT_HAS_TI_TCA6554A_ENABLED
    depends on I2C
    help
        Enable driver for TCA6554A IO expander chip.

config GPIO_TCA6554A_INIT_PRIORITY
    int "Init priority"
    default 70
    depends on GPIO_TCA6554A
    help
        Device driver initialization priority.
```

## dts/bindings/gpio/ti,tca9554a.yaml
```yaml
# Copyright (c) 2022 Chromium OS Authors
# Copyright (c) 2025 Tenstorrent AI ULC
# SPDX-License-Identifier: Apache-2.0
 
description: TI TCA9554A I2C-based GPIO expander

compatible: "ti,tca9554a"

include: [gpio-controller.yaml, i2c-device.yaml]

properties:
    int-gpios:
      type: phandle-array
      required: false
      description: |
          GPIO connected to the controller INT pin. This pin is active-low
          and open-drain.

    "#gpio-cells":
      const: 2

gpio-cells:
  - pin
  - flags
```
